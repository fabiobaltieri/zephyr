## tests/subsys/input/api/testcase.yaml
```yaml
# SPDX-License-Identifier: Apache-2.0

tests:
  subsys.input.api.thread:
    tags: input
    integration_platforms:
      - native_posix
    extra_configs:
      - CONFIG_INPUT_MODE_THREAD=y
      - CONFIG_INPUT_THREAD_STACK_SIZE=1024
  subsys.input.api.synchronous:
    tags: input
    integration_platforms:
      - native_posix
    extra_configs:
      - CONFIG_INPUT_MODE_SYNCHRONOUS=y
  subsys.input.api.thread.zbus:
    tags: input
    integration_platforms:
      - native_posix
    extra_configs:
      - CONFIG_INPUT_MODE_THREAD=y
      - CONFIG_INPUT_THREAD_STACK_SIZE=1024
      - CONFIG_INPUT_ZBUS=y
      - CONFIG_ZBUS_RUNTIME_OBSERVERS_POOL_SIZE=2
  subsys.input.api.synchronous.zbus:
    tags: input
    integration_platforms:
      - native_posix
    extra_configs:
      - CONFIG_INPUT_MODE_SYNCHRONOUS=y
      - CONFIG_INPUT_ZBUS=y
      - CONFIG_ZBUS_RUNTIME_OBSERVERS_POOL_SIZE=3
```
